/*====================================================================================================*/
/*====================================================================================================*/
#include "drivers\stm32f4_system.h"

#include "beanSproutY.h"
/*====================================================================================================*/
/*====================================================================================================*/
void BSY_Init( void )
{
  SystemInit();
  HAL_InitTick();

  BSY_GPIO_Config();
}
/*====================================================================================================*/
/*====================================================================================================*/
void BSY_Loop( void )
{
  while(1) {
    LED_R_Toggle();
    delay_ms(100);
    LED_G_Toggle();
    delay_ms(100);
    LED_B_Toggle();
    delay_ms(100);
    while(KEY_WU_Read()) {
      LED_R_Toggle();
      LED_G_Toggle();
      LED_B_Toggle();
      delay_ms(200);
    }
    while(KEY_BO_Read()) {
      LED_R_Toggle();
      LED_G_Toggle();
      LED_B_Toggle();
      delay_ms(50);
    }
  }
}
/*====================================================================================================*/
/*====================================================================================================*/
